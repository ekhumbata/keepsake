## firmware/components/services/cpu_boost/Kconfig
```kconfig
menu "Keepsake power management"

    config KEEPSAKE_PM_DFS
        bool "Scale the CPU frequency down when idle"
        depends on PM_ENABLE
        default y
        help
            Runs the CPU at KEEPSAKE_PM_MIN_CPU_FREQ_MHZ while nothing needs speed, and at
            the full default CPU frequency while a cpu_boost::ScopedBoost is held (screen
            rendering, input handling, recording). ESP-IDF's frequency scaling does not
            follow load on its own: without a held boost the CPU stays at the minimum, so
            any latency-sensitive work must hold one. Drivers (SPI, I2S, SDMMC, Wi-Fi) keep
            the APB clock up during their transfers by themselves.

    config KEEPSAKE_PM_MIN_CPU_FREQ_MHZ
        int "Idle CPU frequency (MHz)"
        depends on KEEPSAKE_PM_DFS
        range 80 240
        default 80
        help
            80 keeps the APB clock at 80 MHz, which every peripheral here expects. 40 (XTAL)
            is not offered: it would slow the APB clock too.

    config KEEPSAKE_DEV_NO_AUTO_SLEEP
        bool "Dev build: never use automatic light sleep"
        default n
        help
            Automatic light sleep (#55) drops the USB-Serial/JTAG console whenever the chip
            sleeps. Turn this on for development builds to keep the console usable once
            automatic light sleep exists. It has no effect today: automatic light sleep is
            not enabled yet, only frequency scaling.

endmenu
```

## firmware/components/services/net_jobs_service/Kconfig
```kconfig
menu "Keepsake Wi-Fi on demand"

    config KEEPSAKE_WIFI_ON_DEMAND
        bool "Keep the Wi-Fi radio off until network work needs it (experimental)"
        default n
        help
            Off (default): Wi-Fi behaves as it always has -- it connects at boot and stays
            connected -- and network jobs run whenever it is connected.

            On: the radio is off by default. Network jobs (time sync, transcription retries,
            and later weather, downloads and update checks) bring it up, run together, keep it
            on for 30 s in case more follow, then turn it off. With no known network in range
            it waits 30, then 60 minutes before trying again, but anything a person is waiting
            on tries straight away. The radio stays on while the Wi-Fi settings page or the
            setup hotspot is in use. See net_jobs::Scheduler (#17). Needs an on-device check
            before it becomes the default.

    config KEEPSAKE_NET_SYNC_INTERVAL_HOURS
        int "Background sync interval (hours)"
        depends on KEEPSAKE_WIFI_ON_DEMAND
        range 1 48
        default 6
        help
            How often, with Wi-Fi on demand, the radio comes up on its own to sync the time
            and send any recordings still waiting for transcription.

endmenu
```

## firmware/components/services/ota_service/Kconfig
```kconfig
menu "Keepsake updates"

    config KEEPSAKE_OTA_ENABLED
        bool "Check for updates on GitHub Releases"
        default y
        help
            Once a day (and from Settings -> About), fetch the latest release's manifest and,
            if it is newer, download the image into the other app slot. See #40 and the
            release how-to in docs/guide.md.

    config KEEPSAKE_OTA_MANIFEST_URL
        string "Release manifest URL"
        depends on KEEPSAKE_OTA_ENABLED
        default "https://github.com/ekhumbata/keepsake/releases/latest/download/latest.json"
        help
            The small JSON file each release publishes (tools/release/make_manifest.py). The
            "latest" link always points at the newest non-prerelease release.

    config KEEPSAKE_OTA_CHECK_INTERVAL_HOURS
        int "Background check interval (hours)"
        depends on KEEPSAKE_OTA_ENABLED
        range 1 168
        default 24

    config KEEPSAKE_OTA_HEALTH_TIMEOUT_SECONDS
        int "Health check timeout after an update (seconds)"
        range 30 600
        default 90
        help
            A new firmware has this long to reach Home with a working display (and the SD
            card, if it was mounted before the update) and keep running for 20 s. If it
            doesn't, the device goes back to the previous firmware.

endmenu
```

## firmware/components/services/weather_service/Kconfig
```kconfig
menu "Keepsake weather"

    config KEEPSAKE_WEATHER_ENABLED
        bool "Fetch the weather from Open-Meteo"
        default y
        help
            Once an hour, as a background network job, for the place set by the provisioning
            file ("weather_location"). Open-Meteo needs no key. Nothing is fetched without a
            place. See #37.

    config KEEPSAKE_WEATHER_FAHRENHEIT
        bool "Show temperatures in Fahrenheit"
        default n

endmenu
```
